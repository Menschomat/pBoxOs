#pragma once
#include <Arduino.h>
#include <Ethernet.h>
// Set the static IP address to use if the DHCP fails to assign
IPAddress ip(10, 11, 16, 11);
IPAddress dns(10, 11, 15, 3);

// 90:A2:DA:9B:F5:69
// MAC address generated by https://ssl.crox.net/arduinomac/
// see http://blog.crox.net/archives/91-MAC-generator.html
//byte mac[6] = {0x90, 0xA2, 0xDA, 0x9B, 0xF5, 0x69};
byte mac[6] = { 0x90, 0xA2, 0xDA, 0x74, 0x5F, 0xA5 };
EthernetClient eth_client;

void connectEthernet()
{
    if (Ethernet.begin(mac) == 0)
    {
        Serial.println("Failed to configure Ethernet using DHCP");
        // Check for Ethernet hardware present
        if (Ethernet.hardwareStatus() == EthernetNoHardware)
        {
            Serial.println("Ethernet shield was not found.  Sorry, can't run without hardware. :(");
            while (true)
            {
                delay(1); // do nothing, no point running without Ethernet hardware
            }
        }
        if (Ethernet.linkStatus() == LinkOFF)
        {
            Serial.println("Ethernet cable is not connected.");
        }
        // try to configure using IP address instead of DHCP:
        Ethernet.begin(mac, ip, dns);
    }
    else
    {
        Serial.print("  DHCP assigned IP ");
        Serial.println(Ethernet.localIP());
    }
}
